## meta-prolific/conf/layer.conf
```bitbake
# BBPATH adds the layers root directory to BitBakes search path. Similar to the PATH variable.
BBPATH .= ":${LAYERDIR}"

# Defines the location for all recipes in the layer.
BBFILES += "${LAYERDIR}/recipes-*/*/*.bb \
            ${LAYERDIR}/recipes-*/*/*.bbappend"

# Unique ID that OpenEmbedded uses to refer to the layer
BBFILE_COLLECTIONS += "prolific"

# Expands to provide the directory of the layer
BBFILE_PATTERN_prolific = "^${LAYERDIR}/"

# When OE's build system finds a recipe of the same name in a different layer. Higher # = Higher Priority
BBFILE_PRIORITY_prolific = "6"

# Version the layer. Usefule when something else references your layer with LAYERDEPENDS.
LAYERVERSION_yoctobsp = "1"

# Lists all layers that this layer depends on
LAYERDEPENDS_prolific = "core"

# Lists compatible yocto project releases
LAYERSERIES_COMPAT_prolific = "scarthgap"
```
